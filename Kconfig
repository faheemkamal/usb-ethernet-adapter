## Kconfig
```kconfig
config USB_NET_CH9200
    tristate "QinHeng CH9200 USB ethernet support"
    depends on USB_USBNET
    select MII
    help
      Choose this option if you have a USB ethernet adapter with a QinHeng
      CH9200 chipset.

      To compile this driver as a module, choose M here: the
      module will be called ch9200.
```
